// SPDX-License-Identifier: GPL-2.0+ OR MIT
/*
 * Apple TV HD, J42d, AppleTV5,3 (A1625)
 * Copyright (c) 2022, Konrad Dybcio <konradybcio@kernel.org>
 */

/dts-v1/;

#include "t7000.dtsi"

/ {
	compatible = "apple,j42d", "apple,t7000", "apple,arm-platform";
	model = "Apple TV HD";
	chassis-type = "television";
};

&serial0 {
	status = "okay";
};
