## Documentation/devicetree/bindings/leds/backlight/apple,dialog-bl.yaml
```yaml
# SPDX-License-Identifier: (GPL-2.0 OR BSD-2-Clause)
%YAML 1.2
---
$id: http://devicetree.org/schemas/leds/backlight/apple,dialog-bl.yaml#
$schema: http://devicetree.org/meta-schemas/core.yaml#

title: Apple "Dialog" PMIC backlight

maintainers:
  - Nick Chan <towinchenmi@gmail.com>

description:
  This module is part of Apple "Dialog" PMICs. For more details see
  ../mfd/apple,i2c-dialog.yaml.

  A backlight interface in Apple PMICs. There are two variants
  differing in how the backlight value is encoded in the registers.

allOf:
  - $ref: common.yaml#

properties:
  compatible:
    oneOf:
      - items:
          - const: apple,d2207-bl
          - const: apple,d2089-bl
      - items:
          - const: apple,d2400-bl
          - const: apple,d2257-bl
      - const: apple,d2089-bl
      - const: apple,d2257-bl

  reg:
    maxItems: 1

required:
  - compatible
  - reg

additionalProperties: false
```

## Documentation/devicetree/bindings/mfd/apple,i2c-dialog.yaml
```yaml
# SPDX-License-Identifier: (GPL-2.0 OR BSD-2-Clause)
%YAML 1.2
---
$id: http://devicetree.org/schemas/mfd/apple,i2c-dialog.yaml#
$schema: http://devicetree.org/meta-schemas/core.yaml#

title: Apple "Dialog" PMICs over I2C

maintainers:
  - Nick Chan <towinchenmi@gmail.com>

description: |
  Some Apple SoCs comes with PMICs named "Dialog". On A7 - A10X SoCs,
  they are attached over I2C. This binding describes a simple MFD - I2C
  device with 16-bit register address and 8-bit values that allows
  subdevices like RTC, power-off control and backlight to be described.

properties:
  compatible:
    items:
      - enum:
          - apple,d2045
          - apple,d2089
          - apple,d2186
          - apple,d2207
          - apple,d2255
          - apple,d2257
          - apple,d2333
          - apple,d2365
          - apple,d2400
          - apple,d2401
      - const: apple,i2c-dialog

  reg:
    maxItems: 1

  '#address-cells':
    const: 1

  '#size-cells':
    const: 0

patternProperties:
  "^backlight(@[0-9a-f]+)?$":
    $ref: /schemas/leds/backlight/apple,dialog-bl.yaml

required:
  - compatible
  - reg
  - "#address-cells"
  - "#size-cells"

additionalProperties: false

examples:
  - |
    i2c {
      #address-cells = <1>;
      #size-cells = <0>;

      pmu@3c {
        compatible = "apple,d2207", "apple,i2c-dialog";
        reg = <0x3c>;
        #address-cells = <1>;
        #size-cells = <0>;

        backlight@600 {
          compatible = "apple,d2207-bl", "apple,d2089-bl";
          reg = <0x600>;
        };
      };
    };
```

## arch/arm/mach-s5l8747/Kconfig
```kconfig
# SPDX-License-Identifier: GPL-2.0 OR MIT
#
# Copyright (c) 2025 Nick Chan

menuconfig ARCH_S5L8747
	bool "Samsung S5L8747 SoC based platforms"
	depends on ARCH_MULTI_V7
	depends on CPU_LITTLE_ENDIAN
	select ARM_VIC
	select GENERIC_IRQ_CHIP
	select SOC_SAMSUNG
	help
	  This enables support for Samsung S5L8747 SoC.

if ARCH_S5L8747
config CPU_S5L8747
	def_bool y
	help
	  Enable S5L8747 CPU support
endif
```
